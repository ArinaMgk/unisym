; ASCII TAB4 CRLF
; Copyright: ArinaMgk UniSym, Apache License Version 2.0

;TEST PROGRAM
;E:\CNRV\vdkcpy.exe "E:\PROJ\KASHA\KASHADOS[RE]\boot.o" "E:\PROJ\KASHA\KASHADOS[RE]\boot.floppy.img" 0
;E:\CNRV\vdkcpy.exe "E:\PROJ\KASHA\KASHADOS[RE]\test.o" "E:\PROJ\KASHA\KASHADOS[RE]\boot.floppy.img" 1
DB 0x03

JMP ENTRY
STR_1 DB 'KASHA DOS - TEST : HELLO WORLD! - ARINA RET29 ~',0x0D,0x0A,'Here is HardDisk~~',0
ENTRY:
	MOV SI,STR_1
	MOV DI,ENTRY
	MOV AX,0X0800
	MOV DS,AX
	XOR BX,BX
	MOV AH,0X0E
	@LUP:
	MOV AL,BYTE[SI]
	INC SI
	CMP SI,DI
	INT 0x10
	JAE @LUPEND
	JMP @LUP
	XOR BX,BX
	@LUPEND:
	MOV SI,512
	MOV AH,0X0E
	@L1:
	MOV AL,BYTE[DS:SI]
	INC SI
	CMP AL,0
	JE @L1END
	INT 0X10
	JMP @L1
	@L1END:

	MOV SI,1024
	MOV AH,0X0E
	@L2:
	MOV AL,BYTE[DS:SI]
	INC SI
	CMP AL,0
	JE @L2END
	INT 0X10
	JMP @L2
	@L2END:

	AllEnd:HLT
	JMP AllEnd
TIMES 512-$+$$ DB 0
	DB 'THE WORD ZOYO SECOND SECTOR.',0X0D,0X0A,0
TIMES 512*2-$+$$ DB 0
	DB 'THE WORD ZOYO THIRD SECTOR.',0X0D,0X0A,0
TIMES 512*3-$+$$ DB 0