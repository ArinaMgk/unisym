; ASCII [MASM] for MSDOS/WIN16 (C)(ARINAMGK)UNISYM&DOSCONIO
; INT 10 Partial AH from 00 to 0F

; internal - COPROCESSOR ERROR (80286/80386)
; - Generated by the CPU when the -ERROR pin is asserted by the coprocessor. AT's and clones usually wire the coprocessor to use IRQ13, but not all get it right.

; AH = 00h VIDEO - SET VIDEO MODE
; {TODO} ...

; AH = 01h VIDEO - SET CURSOR CHARACTERISTICS - ConCursorStyle
; void <<< ConCursorStyle <<< start(CH)[4b], end(CL)[4b]
; - bits of CH 5-6 = blink attribute (00=normal, 01=invisible, 10=slow, 11=fast)
; - buggy on EGA systems--BIOS remaps cursor shape in 43 line modes, but returns unmapped cursor shape
ConCursorStyle macro start, end
	push ax
	push cx
	mov ah, 001h
	mov ch, start
	mov cl, end
	int 10h
	pop cx
	pop ax
endm

; AH = 02h VIDEO - SET CURSOR POSITION - ConCursorSet (for MASM)
; void <<< ConCursorSet <<< col(DL)=DL[8b], row(DH)=DH[8b], pgno(BH)=0[8b]
; - pgno: 0: graphics modes, 0-3: modes 2&3, 0-7: modes 0&1
ConCursorSet macro col:=<DL>, row:=<DH>, pgno:=<0>
	push ax
	push dx
	push bx
	mov ah, 002h
	mov dh, row
	mov dl, col
	mov bh, pgno
	int 10h
	pop bx
	pop dx
	pop ax
endm

; AH = 03h VIDEO - READ CURSOR POSITION - ConCursorGet (for MASM)
; DH(row), DL(col), CH(StLn), CL(EdLn) <<< ConCursorGet <<< pgno(BH)=0[8b]
ConCursorGet macro pgno:=<0>
	push ax
	push bx
	mov ah, 003h
	mov bh, pgno
	int 10h
	pop bx
	pop ax
endm


; AH = 04h VIDEO - READ LIGHT PEN POSITION (all but PS)
;{TODO}
; Return: AH = 0: light pen switch not activated
; AH = 1: light pen values in registers
; DH,DL = row,column of current position
; CH = raster line (0-199) (EGA) old graphics modes
; CX = (EGA) raster line (0-nnn) new graphics modes
; BX = pixel column (0-319 or 0-639)

; AH = 05h VIDEO - SELECT DISPLAY PAGE - ConPageSet (for MASM)
;{TODO}
; AL =
; 0-7: new page value for modes 0 & 1
; 0-3: new page value for modes 2 & 3
; 80h: read CRT/CPU page registers [PCjr only]
; 81h: set CPU page register to value in BL [PCjr only]
; 82h: set CRT page register to value in BH [PCjr only]
; 83h: set both display registers to values in BH, BL [PCjr only]
; {Corona/Cordata BIOS v4.10+}
; 00h: set address of graphics bitmap buffer (video modes 60h,61h)
; BX = segment of buffer
; 0Fh: get address of graphics bitmap buffer (video modes 60h,61h)
; Return: BH = CRT page register (if AL >= 80h)
; BL = CPU page register (if AL >= 80h)
; DX = segment of graphics bitmap buffer (video modes 60h,61h; AL=0Fh)

; AH = 06h VIDEO - SCROLL PAGE UP - ConRollUp
; void <<< ConRollUp <<< AL(lines)[8b], BH(Attribute)[8b], P0COL(CL), P0ROW(CH), P1COL(DL), P1ROW(DH)
; - AL = number of lines to scroll window (0 = blank whole window)
ConRollUp macro lines, attr, p0col, p0row, p1col, p1row
	push ax
	push cx
	push dx
	push bx
	mov ah, 006h
	mov al, lines
	mov bh, attr
	mov cl, p0col
	mov ch, p0row
	mov dl, p1col
	mov dh, p1row
	int 10h
	pop bx
	pop dx
	pop cx
	pop ax
endm

; AH = 07h VIDEO - SCROLL PAGE DOWN
;{TODO}
; AL = number of lines to scroll window (0 = blank whole window)
; BH = attributes to be used on blanked lines
; CH,CL = row,column of upper left corner of window to scroll
; DH,DL = row,column of lower right corner of window

; AH = 08h VIDEO - READ ATTRIBUTES/CHARACTER AT CURSOR POSITION - ConVideoBufferGetCursor
; AH(Attribute), AL(ASCII) <<< ConVideoBufferGetCursor <<< pgno(BH)=0[8b]
; - Attribute in AlphaMode
ConVideoBufferGetCursor macro pgno:=<0>
	push bx
	mov ah, 008h
	mov bh, pgno
	int 10h
	pop bx
endm

; AH = 09h VIDEO - WRITE ATTRIBUTES/CHARACTERS AT CURSOR POS - ConVideoBufferSetCursor
; void <<< ConVideoBufferSetCursor <<< AL(ASCII)[8b], BL(Attribute)[8b], pgno(BH)=0[8b]
; - BL: attributes of char (alpha modes) or color (graphics modes)
; -     if bit 7 == 1 in graphics mode, character is xor'ed onto screen
; - CX = number of times to write character
; - all characters are displayed, including CR, LF, and BS
ConVideoBufferSetCursor macro ascii, attr, pgno:=<0>
	push ax
	push bx
	push cx
	mov ah, 009h
	mov al, ascii
	mov bl, attr
	mov bh, pgno
	mov cx, 1
	int 10h
	pop cx
	pop bx
	pop ax
endm

; AH = 0Ah VIDEO - WRITE CHARACTERS ONLY AT CURSOR POS - {TODO}
;{INP}AL = character
;{INP}BH = display page - alpha mode
; - BL: color of character (graphics mode, PCjr only)
;       if bit 7 == 1 in graphics mode, character is xor'ed onto screen
; - CX: number of times to write character
;       (EGA) in graphics modes, replication count in CX works correctly only if all character written are contains on the same row
; - all characters are displayed, including CR, LF, and BS

; AH = 0Bh VIDEO - SET COLOR PALETTE
;{TODO}
; BH = 0
; BL = border color (0-15) (text modes) border color and background color (graphics modes)   (EGA)
; BL = border color (0-15) and high-intensity background color  (16-31??? maybe should be high nybble?)
; BH = 1
; BL = palette (0-3)

; AH = 0Ch VIDEO - WRITE DOT ON SCREEN
;{TODO}
; AL = color of dot (0/1 in mode 6, 0-3 in modes 4 and 5)
; 	if bit 7 set, new color will be XORed with current pixel
; BH = display page (ignored if mode only supports one page)
; CX = column
; DX = row
; Note: only valid in graphics modes

; AH = 0Dh VIDEO - READ DOT ON SCREEN
;{TODO}
; BH = display page (ignored if mode only supports one page)
; CX = column
; DX = row
; Return: AL = color read
; Note: only valid in graphics modes

; AH = 0Eh VIDEO - WRITE CHARACTER AND ADVANCE CURSOR (TTY WRITE) - ConPrintCharGFore
; void <<< ConPrintCharGFore <<< AL(ASCII)[8b], BL(ForeColor)[graphics-8b], pgno(BH)=0[alpha-8b]
; - characters 07h (BEL), 08h (BS), 0Ah (LF), and 0Dh (CR) are interpreted and do the expected things
ConPrintCharGFore macro ascii, fore:=<0>, pgno:=<0>
	push ax
	push bx
	mov ah, 00Eh
	mov al, ascii
	mov bl, fore
	mov bh, pgno
	int 10h
	pop bx
	pop ax
endm

; AH = 0Fh VIDEO - GET CURRENT VIDEO MODE - ConModeGet
;{TODO}
;Return: AH = number of columns on screen
;AL = current video mode (see INT 10h/AH=00h)
;BH = current active display page
; - if mode was set with bit 7 set ("no blanking"), the returned mode will also have bit 7 set

